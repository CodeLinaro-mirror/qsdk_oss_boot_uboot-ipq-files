## arch/arm/mach-ipq/Kconfig
```kconfig
if ARCH_IPQ

config SYS_SOC
	default "ipq"

config SYS_VENDOR
	string "IPQ board vendor"
	default "qualcomm"
	help
	  Allows to specify vendor for the IPQ SoCs based boards.
	  Based on this option board/<CONFIG_SYS_VENDOR>/<CONFIG_SYS_BOARD>
	  will be used as the custom board directory.

config SYS_BOARD
	string "IPQ SoCs based board"
	help
	  Allows to specify the IPQ SoCs based board name.
	  Based on this option board/<CONFIG_SYS_VENDOR>/<CONFIG_SYS_BOARD>
	  will be used as the custom board directory.

config SYS_CONFIG_NAME
	string "Board configuration name"
	default SYS_BOARD if SYS_BOARD != ""
	default "qcom"
	help
	  This option contains information about board configuration name.
	  Based on this option include/configs/<CONFIG_SYS_CONFIG_NAME>.h header
	  will be used for board configuration.

config SYS_MALLOC_LEN
	default 0x100000
	help
	  This specifies the size of DRAM reserved for malloc() use.

config SYS_MALLOC_F_LEN
	default 0x10000
	help
	  This specifies the size of the malloc() pool for use before relocation.

config TEXT_SIZE
	hex "Define Size of u-boot text size in DDR region"
	default 0x1C0000 if TARGET_IPQ9574
	default 0x180000 if TARGET_IPQ5332 || TARGET_IPQ5424
	help
	  This option defines the size of the u-boot text in DDR region.

config ARCH_32BIT_SUPPORT
	bool "IPQSOC 32-bit support"
	select CPU_V7A
	select SYS_ARCH_TIMER
	select SYS_THUMB_BUILD
	default n
	help
	  This config provides support for 32-bit IPQSOC.

config IPQ_I2C
        bool "Enable I2C support in IPQ SOC"
        select I2C
        select DM_I2C
        select SYS_I2C_GENI if TARGET_IPQ5424
	select SYS_I2C_QUP if (TARGET_IPQ5332 || TARGET_IPQ9574)
        select CMD_I2C

config ARCH_64BIT_SUPPORT
	bool "IPQSOC 64-bit support"
	select ARM64
	default n
	help
	  This config provides support for 64-bit IPQSOC.

config RAM_NUM_PART_ENTRIES
	int "Number of RAM partition entries which are usable by APPS"
	default 32
	help
	  This config gives the number of RAM partition entries which are usable by APPS.

config NUM_ALT_PARTITION
	int
	default 16
	help
	  This config gives the number of alternate partition.

config RAM_PART_NAME_LENGTH
	int "Max length of ram partition name"
	default 16
	help
	  This specifies the maximum length of the alternate partition.

config NOR_BLK_SIZE
	int "Block size for SPI Nor BLK device"
	depends on NOR_BLK
	default 4096
	help
	  This config specifies the block size for SPI Nor BLK device.

config SECONDARY_UART_INDEX
	int "Access secondary UART via cli"
	default 2
	help
	  This specifies the id inorder to access the secondary UART via cli.

config IPQ_NAND
	bool "Enable NAND flash support in IPQ SOC"
	select MTD
	select DM_MTD
	select CMD_MTD
	select NAND_QTI
	select MTD_RAW_NAND
	select MTD_UBI
	select UBI_WRITE
	select CMD_NAND
	select CMD_UBI
	help
	  Enables support for QPIC NAND controller and its dependent drivers.
	  This option is required to use NAND flash devices connected via the
	  QPIC interface on supported platforms.



config IPQ_SPI_NOR
	bool "Enable SPI NOR flash support in IPQ SOC"
	select MTD
	select SPI
	select MISC
	select SPI_QUP if TARGET_IPQ9574 || TARGET_IPQ5332
	select MSM_GENI_SPI if TARGET_IPQ5424
	select DM_SPI
	select DM_SPI_FLASH
	select SPI_FLASH_STMICRO
	select SPI_FLASH_GIGADEVICE
	select SPI_FLASH_MACRONIX
	select SPI_FLASH_WINBOND
	select SPI_FLASH_SPANSION
	select SPI_FLASH_MTD if ENV_IS_IN_SPI_FLASH
	help
	  This config helps in enabling SPI NOR flash support in IPQ SOC.

config IPQ_NET
	bool "Enable default Network Configurations for IPQ SOC"
	select ETH
	select DM_MDIO
	select MDIO_IPQ4019
	imply MDIO_QCOM_I2C if IPQ_I2C
	select PHYLIB
	select CMD_NET
	select CMD_MDIO
	select CMD_MII
	select CMD_PING
	select CMD_TFTPPUT
	select CMD_DHCP
	select TFTP_PORT
	imply ETH_SKIP_INIT_R
	help
	  This config will enable the Ethernet support in IPQSOC.

config ETH_MAX_MAC
	hex "Define Maximum MAC support in SoC"
	default 2
	help
	  This config defines the maximum MAC support in SoC.

config ETH_MAX_UNIPHY
	int "Maximum number of uniphy available"
	default 2
	help
	  This gives the maximum number of uniphy available.

config IPQ_QCN9224_FUSING
	depends on IPQ_PCIE
	bool "Enable QCN9224 Fusing"
	help
	  This config is to enable QCN9224 Fusing.

config IPQ_SMP_CMD_SUPPORT
	bool "IPQ SMP command support"
	depends on ARCH_32BIT_SUPPORT
	default n
	help
	  This config is to support IPQ SMP command.

config IPQ_SMP64_CMD_SUPPORT
	bool "IPQ SMP64 command support"
	depends on ARCH_64BIT_SUPPORT
	default n
	help
	  This config is to support IPQ SMP64 command.

config CMD_AES_256
	bool "AES 256 command support"
	default n
	help
	  This is to support AES 256 command.

config AES_256_DERIVE_KEY
	bool "AES 256 derive key support"
	depends on CMD_AES_256
	default n
	help
	  This provides support for AES 256 derive key.

config IPQ_USB
	bool "Enable USB support in IPQ SOC"
	select USB
	select MISC
	select USB_HOST
	select USB_DWC3
	select USB_DWC3_GENERIC
	select USB_STORAGE
	select USB_XHCI_HCD
	select DM_USB
	select CMD_USB
	select CMD_FAT
	select FAT_WRITE

config IPQ_TINY
	bool "IPQ Tiny bootloader config"
	imply ETH_LOW_MEM
	default n
	help
	  This configuration helps to enable tiny profile related configurations

config IPQ_MMC
	bool "Enable eMMC support in IPQ SOC"
	select MMC_SDHCI
	select MMC_SDHCI_MSM
	select MMC_SDHCI_ADMA
	select CMD_MMC
	imply EFI_PARTITION
	help
	  This helps in enabling support for eMMC in IPQ SOC.

config SOC_HW_VERSION_REG
	hex "Define SoC HW version register"
	default 0x194D000
	help
	  This config defines the SoC HW version register.

config ETH_MAX_MAC
	hex "Define Maximum MAC support in SoC"
	default 2 if TARGET_IPQ5332
	default 6 if TARGET_IPQ9574
	default 3 if TARGET_IPQ5424
	help
	  This config gives the maximum MAC support in SoC.

config SKIP_RESET
	bool "skip reset"
	default n
	help
	  This configuration helps to skip reset after crashdump collection.

config FAILSAFE
	bool "Enable failsafe mechanism"
	default n
	help
	   This configuration option enables the failsafe mechanism
	   within the system. When activated, the system is capable
	   of booting from an alternative valid bank if the primary bank
	   fails. This ensures continuous operation and reliability
	   by providing a backup boot source, thereby minimizin
	   downtime and enhancing system robustness.

config BOOTCONFIG_V2
	bool "Enable Boot Configuration Version 2"
	imply FAILSAFE
	default n
	help
	   This configuration option enables Boot Configuration
	   Version 2 (BOOTCONFIG_V2).

config BOOTCONFIG_V3
	bool "Enable Boot Configuration Version 3"
	imply FAILSAFE
	default n
	help
	   This configuration option enables Boot Configuration
	   Version 3 (BOOTCONFIG_V3).

config CRC32_BE
	bool "Enable CRC32 calculation in big-endian format"
	default y if FAILSAFE
	help
	   This configuration option enables support for CRC32
	   calculations in a big-endian format.

config SCM
	bool "Add scm call support"
	help
	  This config is to add support for SCM calls.

config SCM_V1
	bool "SCM framework version 1"
	select SCM
	default n
	help
	  This config provides support for SCM framework version 1 (SCM_V1).

config SCM_V2
	bool "SCM framework version 2"
	select SCM
	default n
	help
	  This config provides support for SCM framework version 2 (SCM_V2).

config SECURE_AUTH_V1
	bool "Secure authentication command"
	default n
	help
	  This config provides support to authenticate secure images

config SECURE_AUTH_V2
	bool "Secure authentication command"
	default n
	help
	  This config provides support to authenticate secure images

config FUSE_IPQ
	bool "Enable fuseipq command support"
	depends on IPQ_SECURE
	default n
	help
	  This config provides support for fuseipq command.

config FUSEIPQ_V1
	bool "Enable fuseipq command support with version 1"
	default n
	help
	  This config provides support for fuseipq command version 1.

config FUSEIPQ_V2
	bool "Enable fuseipq command support with version 2"
	default n
	help
	  This config provides support for fuseipq command version 2.

config LIST_FUSE
	bool "Enable list_fuse command"
	default n
	help
	  This option supports in enabling list_fuse command.

config LIST_FUSE_V1
        bool "Enable list_fuse command with version 1"
        default n
	help
	  This config supports to dump fuse sense register

config LIST_FUSE_V2
        bool "Enable list_fuse command with version 2"
        default n
	help
	  This config supports to dump fuse sense register

config IPQ_ROOTFS_AUTH
	bool "Rootfs authentication support"
	depends on IPQ_SECURE && (TARGET_IPQ9574 || TARGET_IPQ5332)
	default n
	help
	    This configuration option enables the Rootfs authentication support
	    in IPQ9574 & IPQ5332 only.

config IPQ_ELF_AUTH
	bool "IPQSOC elf image authentication"
	default n
	help
	   This configuration option enables the authentication method via
	   elf based.

config VERSION_ROLLBACK_PARTITION_INFO
	bool "IPSOC Anti roll-back support"
	default n
	help
	  This configuration add support to enable anti-rollback version feature,
	  once the image is upgraded to newer version, it cannot be downgraded

config DPR_VER_1_0
	bool "DPR Version 1.0 support"
	default n
	help
	  This option provides support for DPR Version 1.0
	  It helps in executing dpr_execute in u-boot.

config DPR_VER_2_0
	bool "DPR Version 2.0 support"
	default n
        help
          This option provides support for DPR Version 2.0
          It helps in executing dpr_execute in u-boot.

config DPR_VER_3_0
	bool "DPR Version 3.0 support"
	default n
        help
          This option provides support for DPR Version 3.0
          It helps in executing dpr_execute in u-boot.

config DPR_VERSION
	int "Current DPR version"
	default 1 if DPR_VER_1_0
	default 2 if DPR_VER_2_0
	default 3 if DPR_VER_3_0
	help
	  This gives the current DPR version.
	  It helps in executing dpr_execute in u-boot.

config IPQ_SECURE
	bool "IPQSOC secure call support"
	imply IPQ_ELF_AUTH
	default n
	help
	   This configuration option enables secure boot support,
	   where the kernel and optionally the root filesystem are
	   authenticated before booting.

config MMC_FLASH_PARTITION_WRITE_PROTECT
	bool "This enable wrtie protect in EMMC flash type"
	depends on IPQ_MMC
	default y

config IPQ_CRASHDUMP
	bool "IPQ Crashdump collection support"
	depends on USE_PREBOOT
	default n

config IPQ_MINIDUMP
	bool "IPQ Minidump collection support"
	depends on IPQ_CRASHDUMP
	default n

config IPQ_COMPRESSED_CRASHDUMP
	bool "IPQ Compressed (GZIP) Crashdump support"
	depends on IPQ_CRASHDUMP
	select CMD_ZIP
	default n

config IPQ_CRASHDUMP_TO_USB
	bool "IPQ Collect Crashdump over USB"
	depends on IPQ_CRASHDUMP && IPQ_USB
	default n

config IPQ_CRASHDUMP_TO_MEMORY
	bool "IPQ Collect Crashdump over DDR Memory"
	depends on IPQ_CRASHDUMP
	default n

config IPQ_CRASHDUMP_TO_NVMEMORY
	bool "IPQ Collect Crashdump over Non-Volatile Memory (eMMC / NAND)"
	depends on IPQ_CRASHDUMP
	default n

config IPQ_CRASHDUMP_TO_FLASH
	bool "IPQ Collect Crashdump over FLASH"
	depends on IPQ_CRASHDUMP && IPQ_MINIDUMP
	default n

config IPQ_CRASHDUMP_TO_EMMC
	bool "IPQ Collect Crashdump over EMMC"
	depends on IPQ_CRASHDUMP && IPQ_COMPRESSED_CRASHDUMP && IPQ_MMC
	imply CMD_EXT4
	imply CMD_EXT4_WRITE
	default n

config IPQ_PCIE
	bool "Enable PCIE support in IPQ SOC"
	select PCI
	select PCIE_DW_QCOM
	select PHY_QCOM_QMP_PCIE if TARGET_IPQ9574 || TARGET_IPQ5424
	select PHY_QCOM_UNIPHY_PCIE if TARGET_IPQ5332
	select CMD_PCI
	select PHY
	help
	   This configuration option enables PCIE support in IPQ SoC's.

config IPQ_MAX_PCIE
	int "Max PCIE supported in IPQSOC"
	depends on PCI
	default 3 if TARGET_IPQ5332
	default 4 if TARGET_IPQ9574
	default 4 if TARGET_IPQ5424
	help
	   This config declare maximum PCIE in SoC.

config IPQ_STOP_WDT
	bool "Stop WDT if autoboot abort"
	depends on WDT
	default y
	help
	   This config stop watchdog if autoboot abort.

config GPT_UPDATE_PARAMS
	bool "Update GPT parameters"
	depends on IPQ_MMC || NOR_BLK
	default n
	help
	   Enable this option to update the backup GPT location in the GPT
	   header based on the actual device size, if required.

config DEFAULT_MMC_FLASH_SIZE
	int "Default MMC flash size (in MB)"
	default 15269888
	help
	   Specifies the default MMC flash size used when generating GPT
	   partitions via GPT tools.

config DEFAULT_NOR_FLASH_SIZE
	int "Default NOR flash size (in MB)"
	default 8192
	help
	   Specifies the default SPI-NOR flash size used when generating GPT
	   partitions via GPT tools

config MTDPARTS_MAXLEN
	int "mdtparts string maximum length"
	depends on CMD_MTDPARTS
	default 1024
	help
	  This configuration helps to set maximum mtdpart string length

config BASE_CPU_64BIT_BOOTUP
	bool "Base CPU 64-bit boot up"
	default n

config IPQ_BOARD_DEFAULT
	bool "Enable default config for all SoC"
	default y
	imply BOARD_TYPES
	imply BOARD_LATE_INIT
	imply CMD_MEMTEST
	imply CMD_MTDPARTS if MTD
	imply CMD_WDT
	imply DM_WARN
	imply ENV_IS_NOWHERE
	imply FDT_FIXUP_PARTITIONS if MTD
	imply HUSH_PARSER
	imply OF_BOARD_SETUP
	imply STACKPROTECTOR
	imply SYS_DEVICE_NULLDEV
	imply IPQ_CRASHDUMP
	imply IPQ_MINIDUMP
	imply IPQ_COMPRESSED_CRASHDUMP
	imply IPQ_CRASHDUMP_TO_USB
	imply IPQ_CRASHDUMP_TO_MEMORY
	imply IPQ_CRASHDUMP_TO_NVMEMORY
	imply IPQ_CRASHDUMP_TO_FLASH
	imply IPQ_CRASHDUMP_TO_EMMC
	imply LZMA
	imply WDT
	imply WDT_QCOM
	help
	  This config enables default configuration support for all SoCs.

choice
	prompt "IPQ board select"

config TARGET_IPQ5332
	bool "QCOM IPQ5332 SOC"
	imply DMA
	imply DMA_CHANNELS
	imply BOOTCONFIG_V2
	imply SCM_V1
	imply IPQ_SECURE
	select BAM_DMA if DMA
	select IPQ_NET
	select QCOM_NSS_SWITCH
	imply PHY_QCA_8X8X
	imply PHY_QCA_81XX
	imply PHY_QCA_8081
	imply PHY_QCA_8033
	imply PHY_AQUANTIA
	select CMD_CACHE
	imply IPQ_I2C
	imply FUSE_IPQ
	imply LIST_FUSE
	imply SECURE_AUTH_V1 if IPQ_SECURE && SCM_V1
	imply FUSEIPQ_V1 if IPQ_SECURE && SCM_V1
	imply LIST_FUSE_V2 if IPQ_SECURE && SCM_V1
	imply VERSION_ROLLBACK_PARTITION_INFO if IPQ_SECURE
	imply IPQ_QCN9224_FUSING
	imply DPR_VER_2_0
	imply IPQ_SMP_CMD_SUPPORT
	imply IPQ_SMP64_CMD_SUPPORT
	imply CMD_AES_256
	imply MMC
	imply SUPPORT_EMMC_BOOT
	imply AES_256_DERIVE_KEY
	imply IPQ_PCIE
	imply IPQ_USB
	imply PHY if IPQ_USB
	imply PHY_QCOM_USB_HS_M31 if IPQ_USB
	imply PHY_QCOM_UNI_SSPHY if IPQ_USB
	help
	  Support for the IPQ53XX SoC.
	  - Board Open Platform Specifications.
	  - Quad Cores A53, Nom@1.2G ,Turbo@1.5G, L1@32KB L2@512KB
	  - DDR3L/DDR4
	  - QSPI NAND / NOR / eMMC
	  - USB 3.0/I2C/UART/PCIe Gen3 2Lane
	  - 1G/2.5G/10G Ethernet Ports

config TARGET_IPQ9574
	bool "QCOM IPQ9574 SOC"
	imply DMA
	imply DMA_CHANNELS
	imply BOOTCONFIG_V2
	imply SCM_V1
	imply IPQ_SECURE
	select BAM_DMA if DMA
	select IPQ_NET
	select QCOM_NSS_SWITCH
	imply PHY_QCA_8X8X
	imply PHY_QCA_81XX
	imply PHY_QCA_8075
	imply PHY_QCA_8081
	imply PHY_AQUANTIA
	select CMD_CACHE
	imply IPQ_I2C
	imply FUSE_IPQ
	imply SECURE_AUTH_V1 if IPQ_SECURE && SCM_V1
	imply FUSEIPQ_V1 if IPQ_SECURE && SCM_V1
	imply LIST_FUSE_V1 if IPQ_SECURE && SCM_V1
	imply LIST_FUSE
	imply VERSION_ROLLBACK_PARTITION_INFO if IPQ_SECURE
	imply IPQ_QCN9224_FUSING
	imply DPR_VER_1_0
	imply IPQ_SMP_CMD_SUPPORT
	imply IPQ_SMP64_CMD_SUPPORT
	imply CMD_AES_256
	select QSPI_LAYOUT_SWITCH if IPQ_NAND
	imply MMC
	imply SUPPORT_EMMC_BOOT
	imply AES_256_DERIVE_KEY
	imply IPQ_PCIE
	imply IPQ_USB
	imply PHY if IPQ_USB
	imply PHY_QCOM_QUSB2 if IPQ_USB
	imply PHY_QCOM_QMP_USB3 if IPQ_USB
	help
	  Support for IPQ95xx SoC.
	  - Board Open Platform Specifications.
	  - Quad Cores A73, max@2.2G, L1@32KB L2@512KB
	  - DDR3L/DDR4
	  - QSPI NAND / NOR / eMMC
	  - USB 3.0/I2C/UART/PCIe Gen3 2Lane
	  - 1G/2.5G/10G Ethernet Ports

config TARGET_IPQ5424
	bool "QCOM IPQ5424"
	select BASE_CPU_64BIT_BOOTUP
	imply NOR_BLK
	imply BOOTCONFIG_V3
	imply SCM_V2
	imply IPQ_SECURE
	imply SHA384
	select IPQ_NET
	select QCOM_NSS_SWITCH
	imply PHY_QCA_8X8X
	imply PHY_QCA_81XX
	imply PHY_QCA_8081
	imply PHY_AQUANTIA
	select CMD_CACHE
	imply IPQ_I2C
	imply QCOM_GENI_SE
	imply FUSE_IPQ
	imply SECURE_AUTH_V2 if IPQ_SECURE && SCM_V2
	imply FUSEIPQ_V2 if IPQ_SECURE && SCM_V2
	imply LIST_FUSE_V2 if IPQ_SECURE && SCM_V2
	imply LIST_FUSE
	imply IPQ_QCN9224_FUSING
	imply DPR_VER_3_0
	imply IPQ_SMP_CMD_SUPPORT
	imply IPQ_SMP64_CMD_SUPPORT
	imply CMD_AES_256
	imply MMC
	imply SUPPORT_EMMC_BOOT
	imply AES_256_DERIVE_KEY
	imply IPQ_PCIE
	imply GPT_UPDATE_PARAMS
	imply IPQ_USB
	imply PHY if IPQ_USB
	imply PHY_QCOM_QUSB2 if IPQ_USB
	imply PHY_QCOM_QMP_USB3 if IPQ_USB
	help
	  Support for IPQ5424 SoC.
	  - Board Open Platform Specifications.
	  - Quad Cores A55, Nom@1.4G, Turbo@1.8G, L1@32KB L2@512KB, L3@1MB
	  - DDR3L/DDR4
	  - QSPI NAND / NOR / eMMC
	  - USB 3.0/I2C/UART/PCIe Gen3 2Lane
	  - 2.5G/10G Ethernet Ports

endchoice

endif
```
