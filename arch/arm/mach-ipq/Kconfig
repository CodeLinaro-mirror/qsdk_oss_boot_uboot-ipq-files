## configs/ipq5210_nand_defconfig
```kconfig
CONFIG_ARM=y
CONFIG_ARCH_IPQ=y
CONFIG_ARCH_64BIT_SUPPORT=y
CONFIG_SYS_BOARD="ipq5210"
CONFIG_SYS_CONFIG_NAME="ipq5210"
CONFIG_SYS_PROMPT="IPQ5210# "
CONFIG_TARGET_IPQ5210=y
CONFIG_SKIP_LOWLEVEL_INIT=y
CONFIG_NR_DRAM_BANKS=2
CONFIG_TEXT_BASE=0x8A380000
CONFIG_TEXT_SIZE=0x180000
CONFIG_SYS_LOAD_ADDR=0x90000000
CONFIG_SYS_MALLOC_LEN=0xC0000
CONFIG_STACK_SIZE=0x80000
CONFIG_DEFAULT_DEVICE_TREE="ipq5210-emulation"
CONFIG_OF_LIST="ipq5210-emulation"
CONFIG_FIT=y
CONFIG_FIT_VERBOSE=y
CONFIG_BOOTSTD_FULL=y
CONFIG_BOOTDELAY=2
CONFIG_OF_BOARD_SETUP=y
CONFIG_SYS_CBSIZE=1024
CONFIG_MSM_GPIO=y
CONFIG_CLK_QCOM_IPQ5210=y
CONFIG_PINCTRL_QCOM_IPQ5210=y
CONFIG_QCOM_GENI_SE=y
CONFIG_MSM_GENI_SERIAL=y
CONFIG_BOARD_EARLY_INIT_F=y
CONFIG_PINCONF=y
# CONFIG_MMC is not set
CONFIG_IPQ_NAND=y
CONFIG_IPQ_FLASH_PART_FIXUP=y
# CONFIG_CMD_UBIFS is not set
CONFIG_ENV_IS_IN_NAND=y
CONFIG_ENV_SIZE=0x40000
CONFIG_ENV_RANGE=0x80000
CONFIG_ENV_OFFSET=0xf80000
CONFIG_BOOTCOMMAND="bootipq"
CONFIG_BOOTARGS="console=ttyMSM0,115200n8"
# CONFIG_DISPLAY_CPUINFO is not set
# CONFIG_CMD_BOOTI is not set
CONFIG_BOARD_EARLY_INIT_R=y
CONFIG_MULTI_DTB_FIT=y
CONFIG_MULTI_DTB_FIT_GZIP=y
CONFIG_SYS_MALLOC_F=y
CONFIG_SYS_MALLOC_F_LEN=0x40000
CONFIG_DTB_RESELECT=y
CONFIG_LZMA=y
CONFIG_MULTI_DTB_FIT_USER_DEFINED_AREA=y
CONFIG_MULTI_DTB_FIT_USER_DEF_ADDR=0x8A500000
CONFIG_MULTI_DTB_FIT_UNCOMPRESS_SZ=0x100000
# CONFIG_EFI_LOADER is not set
CONFIG_COUNTER_FREQUENCY=24000000
# CONFIG_OF_UPSTREAM is not set
# CONFIG_ENV_IS_NOWHERE is not set
```

## configs/ipq5332_mmc_defconfig
```kconfig
CONFIG_ARM=y
CONFIG_ARCH_IPQ=y
CONFIG_ARCH_64BIT_SUPPORT=y
CONFIG_SYS_BOARD="ipq5332"
CONFIG_SYS_CONFIG_NAME="ipq5332"
CONFIG_SYS_PROMPT="IPQ5332# "
CONFIG_TARGET_IPQ5332=y
CONFIG_SKIP_LOWLEVEL_INIT=y
CONFIG_POSITION_INDEPENDENT=y
CONFIG_NR_DRAM_BANKS=1
CONFIG_TEXT_BASE=0x4A280000
CONFIG_TEXT_SIZE=0x180000
CONFIG_SYS_LOAD_ADDR=0x50000000
CONFIG_DEVICE_TREE_INCLUDES="ipq5332-u-boot.dtsi"
CONFIG_DEFAULT_DEVICE_TREE="qcom/ipq5332-rdp468"
CONFIG_OF_LIST="qcom/ipq5332-rdp468 qcom/ipq5332-rdp442 qcom/ipq5332-rdp441 qcom/ipq5332-rdp474"
CONFIG_FIT=y
CONFIG_FIT_VERBOSE=y
CONFIG_BOOTSTD_FULL=y
CONFIG_BOOTDELAY=2
CONFIG_OF_BOARD_SETUP=y
CONFIG_SYS_CBSIZE=1024
# CONFIG_DISPLAY_CPUINFO is not set
# CONFIG_EFI_LOADER is not set
CONFIG_OF_LIVE=y
CONFIG_MSM_GPIO=y
CONFIG_CLK_QCOM_IPQ5332=y
CONFIG_PINCTRL_QCOM_IPQ5332=y
CONFIG_MSM_SERIAL=y
CONFIG_BOARD_EARLY_INIT_F=y
CONFIG_PINCONF=y
CONFIG_IPQ_MMC=y
CONFIG_MULTI_DTB_FIT_UNCOMPRESS_SZ=0x20000
CONFIG_SYS_MALLOC_F_LEN=0x40000
```

## configs/ipq5424_norplusmmc_defconfig
```kconfig
CONFIG_ARM=y
CONFIG_ARCH_IPQ=y
CONFIG_ARCH_64BIT_SUPPORT=y
CONFIG_SYS_BOARD="ipq5424"
CONFIG_SYS_CONFIG_NAME="ipq5424"
CONFIG_SYS_PROMPT="IPQ5424# "
CONFIG_TARGET_IPQ5424=y
CONFIG_SKIP_LOWLEVEL_INIT=y
CONFIG_POSITION_INDEPENDENT=y
CONFIG_NR_DRAM_BANKS=2
CONFIG_TEXT_BASE=0x8A380000
CONFIG_TEXT_SIZE=0x180000
CONFIG_SYS_LOAD_ADDR=0x90000000
CONFIG_SYS_MALLOC_LEN=0xC0000
CONFIG_SYS_MALLOC_F_LEN=0x1000
CONFIG_ENV_SIZE=0x40000
CONFIG_STACK_SIZE=0x80000
CONFIG_DEVICE_TREE_INCLUDES="ipq5424-u-boot.dtsi"
CONFIG_DEFAULT_DEVICE_TREE="qcom/ipq5424-rdp466"
CONFIG_OF_LIST="qcom/ipq5424-rdp466"
CONFIG_FIT=y
CONFIG_FIT_VERBOSE=y
CONFIG_BOOTSTD_FULL=y
CONFIG_BOOTDELAY=2
CONFIG_OF_BOARD_SETUP=y
CONFIG_SYS_CBSIZE=1024
# CONFIG_DISPLAY_CPUINFO is not set
# CONFIG_EFI_LOADER is not set
CONFIG_OF_LIVE=y
CONFIG_MSM_GPIO=y
CONFIG_CLK_QCOM_IPQ5424=y
CONFIG_PINCTRL_QCOM_IPQ5424=y
CONFIG_MSM_GENI_SERIAL=y
CONFIG_BOARD_EARLY_INIT_F=y
CONFIG_PINCONF=y
CONFIG_IPQ_MMC=y
CONFIG_MULTI_DTB_FIT_UNCOMPRESS_SZ=0x20000
CONFIG_SYS_MALLOC_F_LEN=0x40000
CONFIG_SF_DEFAULT_BUS=0
CONFIG_SF_DEFAULT_CS=0
CONFIG_SF_DEFAULT_MODE=0x0
CONFIG_SF_DEFAULT_SPEED=50000000
# CONFIG_SPI_FLASH_USE_4K_SECTORS is not set
CONFIG_ENV_IS_IN_SPI_FLASH=y
CONFIG_ENV_OFFSET=0x530000
CONFIG_ENV_SIZE=0x10000
CONFIG_ENV_RANGE=0x10000
CONFIG_ENV_SECT_SIZE=0x10000
CONFIG_IPQ_SPI_NOR=y
```

## configs/ipq5610_norplusmmc_defconfig
```kconfig
CONFIG_ARM=y
CONFIG_ARCH_IPQ=y
CONFIG_ARCH_64BIT_SUPPORT=y
CONFIG_ARM_SMCCC=y
CONFIG_HAS_VBAR=y
CONFIG_SYS_BOARD="ipq5610"
CONFIG_SYS_CONFIG_NAME="ipq5610"
CONFIG_SYS_PROMPT="IPQ5610# "
CONFIG_TARGET_IPQ5610=y
CONFIG_SKIP_LOWLEVEL_INIT=y
CONFIG_NR_DRAM_BANKS=2
CONFIG_TEXT_BASE=0x8A280000
CONFIG_TEXT_SIZE=0x180000
CONFIG_SYS_LOAD_ADDR=0x90000000
CONFIG_DEFAULT_DEVICE_TREE="ipq5610-emulation"
CONFIG_DMA=y
CONFIG_FIT=y
CONFIG_FIT_VERBOSE=y
CONFIG_BOOTDELAY=2
CONFIG_OF_BOARD_SETUP=y
CONFIG_SYS_CBSIZE=1024
# CONFIG_EFI_LOADER is not set
CONFIG_CLK=y
CONFIG_MSM_GPIO=y
CONFIG_CLK_QCOM_IPQ5610=y
CONFIG_PINCTRL=y
CONFIG_PINCTRL_QCOM_IPQ5610=y
CONFIG_MSM_GENI_SERIAL=y
CONFIG_BOARD_EARLY_INIT_F=y
CONFIG_PINCONF=y
CONFIG_FIRMWARE=y
CONFIG_QCOM_GENI_SE=y
CONFIG_IPQ_MMC=y
CONFIG_IPQ_SPI_NOR=y
CONFIG_SF_DEFAULT_BUS=0
CONFIG_SF_DEFAULT_CS=0
CONFIG_SF_DEFAULT_MODE=0x0
CONFIG_SF_DEFAULT_SPEED=50000000
# CONFIG_SPI_FLASH_USE_4K_SECTORS is not set
CONFIG_ENV_IS_IN_SPI_FLASH=y
CONFIG_ENV_OVERWRITE=y
CONFIG_ENV_OFFSET=0xEB0000
CONFIG_ENV_SECT_SIZE=0x10000
CONFIG_ENV_SIZE=0x10000
CONFIG_ENV_RANGE=0x10000
# CONFIG_PSCI_RESET is not set
CONFIG_BOOTCOMMAND="bootipq"
CONFIG_USE_BOOTARGS=y
CONFIG_BOOTARGS="console=ttyMSM0,115200n8"
# CONFIG_DISPLAY_CPUINFO is not set
CONFIG_BOARD_EARLY_INIT_R=y
CONFIG_SYS_MALLOC_F=y
CONFIG_SYS_MALLOC_F_LEN=0x40000
CONFIG_SYS_MALLOC_LEN=0xC0000
CONFIG_STACK_SIZE=0x80000
CONFIG_LZMA=y
# CONFIG_CMD_BOOTI is not set
# CONFIG_BOOTSTD is not set
# CONFIG_DDR_SI_TEST is not set
# CONFIG_LEGACY_HASHING_AND_CRYPTO is not set
# CONFIG_CMD_ELF_BOOTVX is not set
# CONFIG_SHA1_LEGACY is not set
CONFIG_COUNTER_FREQUENCY=24000000
CONFIG_USE_BOOTCOMMAND=y
# CONFIG_OF_UPSTREAM is not set
CONFIG_ETH_MAX_MAC=2
CONFIG_RUNTIME_SF_ENV_UPDATE=y
CONFIG_SUPPORT_EMMC_BOOT=y
CONFIG_QSPI_SERIAL_TRAINING=y
```

## configs/ipq9574_mmc32_defconfig
```kconfig
CONFIG_ARM=y
CONFIG_ARCH_IPQ=y
CONFIG_ARCH_32BIT_SUPPORT=y
CONFIG_ARM_SMCCC=y
CONFIG_HAS_VBAR=y
CONFIG_SYS_BOARD="ipq9574"
CONFIG_SYS_CONFIG_NAME="ipq9574"
CONFIG_SYS_PROMPT="IPQ9574# "
CONFIG_TARGET_IPQ9574=y
CONFIG_SKIP_LOWLEVEL_INIT=y
CONFIG_POSITION_INDEPENDENT=y
CONFIG_NR_DRAM_BANKS=1
CONFIG_TEXT_BASE=0x4A240000
CONFIG_TEXT_SIZE=0x1C0000
CONFIG_SYS_LOAD_ADDR=0x50000000
CONFIG_OF_EMBED=y
CONFIG_DEVICE_TREE_INCLUDES="ipq9574-u-boot.dtsi"
CONFIG_DEFAULT_DEVICE_TREE="qcom/ipq9574-rdp433"
CONFIG_FIT=y
CONFIG_FIT_VERBOSE=y
CONFIG_BOOTSTD_FULL=y
CONFIG_BOOTDELAY=2
CONFIG_OF_BOARD_SETUP=y
CONFIG_SYS_CBSIZE=1024
# CONFIG_DISPLAY_CPUINFO is not set
# CONFIG_EFI_LOADER is not set
CONFIG_OF_LIVE=y
CONFIG_MSM_GPIO=y
CONFIG_CLK_QCOM_IPQ9574=y
CONFIG_PINCTRL_QCOM_IPQ9574=y
CONFIG_MSM_SERIAL=y
CONFIG_BOARD_EARLY_INIT_F=y
CONFIG_PINCONF=y
CONFIG_IPQ_MMC=y
```

## configs/ipq9650_nand_defconfig
```kconfig
# CONFIG_CMD_BOOTI is not set
# CONFIG_CMD_UBIFS is not set
# CONFIG_DISPLAY_CPUINFO is not set
# CONFIG_EFI_LOADER is not set
# CONFIG_ENV_IS_NOWHERE is not set
# CONFIG_MMC is not set
# CONFIG_OF_UPSTREAM is not set
CONFIG_ARCH_64BIT_SUPPORT=y
CONFIG_ARCH_IPQ=y
CONFIG_ARM=y
CONFIG_BOARD_EARLY_INIT_F=y
CONFIG_BOARD_EARLY_INIT_R=y
CONFIG_BOOTARGS="console=ttyMSM0,115200n8"
CONFIG_BOOTCOMMAND="bootipq"
CONFIG_USE_PREBOOT=y
CONFIG_PREBOOT="crashdump"
CONFIG_BOOTDELAY=2
CONFIG_BOOTSTD_FULL=y
CONFIG_CLK_QCOM_IPQ9650=y
CONFIG_COUNTER_FREQUENCY=24000000
CONFIG_DEFAULT_DEVICE_TREE="ipq9650-emulation"
CONFIG_ENV_IS_IN_NAND=y
CONFIG_ENV_OFFSET=0xf80000
CONFIG_ENV_RANGE=0x80000
CONFIG_ENV_SIZE=0x40000
CONFIG_FIT=y
CONFIG_FIT_VERBOSE=y
CONFIG_GPIO=y
CONFIG_HAS_VBAR=y
CONFIG_HUSH_PARSER=y
CONFIG_IPQ_FLASH_PART_FIXUP=y
CONFIG_IPQ_NAND=y
CONFIG_IPQ_SPI_NOR=y
CONFIG_LOCALVERSION=""
CONFIG_LOCALVERSION_AUTO=y
CONFIG_LZMA=y
CONFIG_MSM_GENI_SERIAL=y
CONFIG_MSM_GPIO=y
CONFIG_MSM_SMEM=y
CONFIG_NR_DRAM_BANKS=2
CONFIG_OF_BOARD_SETUP=y
CONFIG_PINCONF=y
CONFIG_PINCTRL_QCOM_IPQ9650=y
CONFIG_QCOM_GENI_SE=y
CONFIG_SKIP_LOWLEVEL_INIT=y
CONFIG_STACK_SIZE=0x80000
CONFIG_SYS_BOARD="ipq9650"
CONFIG_SYS_CBSIZE=1024
CONFIG_SYS_CONFIG_NAME="ipq9650"
CONFIG_SYS_LOAD_ADDR=0x90000000
CONFIG_SYS_MALLOC_F=y
CONFIG_SYS_MALLOC_F_LEN=0x40000
CONFIG_SYS_MALLOC_LEN=0xC0000
CONFIG_SYS_PROMPT="IPQ9650# "
CONFIG_TARGET_IPQ9650=y
CONFIG_TEXT_BASE=0x8A280000
CONFIG_TEXT_SIZE=0x180000
```

## drivers/net/qcom/Kconfig
```kconfig
config ETH_IPQ5332
	depends on DM && QCOM_NSS_SWITCH && TARGET_IPQ5332
	default y
	bool "Ethernet driver for QCOM IPQ5332"
	help
	  Enable this to support the ethernet in IPQ5332 SoCs.

config ETH_IPQ9574
	depends on DM && QCOM_NSS_SWITCH && TARGET_IPQ9574
	default y
	bool "Ethernet driver for QCOM IPQ9574"
	help
	  Enable this to support the ethernet in QCOM IPQ9574 Soc.

config ETH_IPQ5424
	depends on DM && QCOM_NSS_SWITCH && TARGET_IPQ5424
	default y
	bool "Ethernet driver for QCOM IPQ5424"
	help
	  Enable this to support the ethernet in QCOM IPQ5424 Soc.

config ETH_LOW_MEM
	depends on DM && QCOM_NSS_SWITCH
	default n
	bool "Enable low memory configuration on IPQ ethernet driver"
	help
	  Enable low memory configuration on IPQ SoC ethernet driver
```
