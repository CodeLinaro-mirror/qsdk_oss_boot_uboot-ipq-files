// SPDX-License-Identifier: GPL-2.0-only
/*
 * Copyright (c) Qualcomm Technologies, Inc. and/or its subsidiaries.
 */

/dts-v1/;

#include "ipq9650-u-boot.dtsi"

/ {
	model = "Qualcomm Technologies, Inc. IPQ9650 DB-JU02";
	compatible = "qcom,ipq9650-db-ju02", "qcom,ipq9650";
};
