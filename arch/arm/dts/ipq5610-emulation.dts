// SPDX-License-Identifier: GPL-2.0-only
/*
 * Copyright (c) Qualcomm Technologies, Inc. and/or its subsidiaries.
 */

/dts-v1/;

#include "ipq5610-u-boot.dtsi"

/ {
	model = "Qualcomm Technologies, Inc. IPQ5610-EMULATION";
	compatible = "qcom,ipq5610-emulation", "qcom,ipq5610";
};
