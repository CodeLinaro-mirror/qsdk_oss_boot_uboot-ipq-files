// SPDX-License-Identifier: GPL-2.0-only
/*
 * Copyright (c) Qualcomm Technologies, Inc. and/or its subsidiaries.
 */

/dts-v1/;

#include "ipq5210-u-boot.dtsi"

/ {
	model = "Qualcomm Technologies, Inc. IPQ5210 RDP512";
	compatible = "qcom,ipq5210-rdp512", "qcom,ipq5210";
};
