// SPDX-License-Identifier: GPL-2.0+
/*
 * Copyright (c) 2025, Qualcomm Innovation Center, Inc. All rights reserved.
 */

#include <arm64/qcom/ipq9574-rdp454.dts>

/ {
	chosen {
		stdout-path = "serial0";
	};
};
