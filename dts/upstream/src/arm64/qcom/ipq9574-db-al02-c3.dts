// SPDX-License-Identifier: GPL-2.0-only
/*
 * Copyright (c) Qualcomm Technologies, Inc. and/or its subsidiaries.
 */

/dts-v1/;

#include "ipq9574-rdp-common.dtsi"

/ {
	model = "Qualcomm Technologies, Inc. IPQ9574/DB-AL02-C3";
	compatible = "qcom,ipq9574-db-al02-c3", "qcom,ipq9574";
	config_name = "config@db-al02-c3", "config-db-al02-c3";
};
