// SPDX-License-Identifier: GPL-2.0-only
/*
 * IPQ9574 RDP449 board device tree source
 *
 * Copyright (c) Qualcomm Technologies, Inc. and/or its subsidiaries.
 */

/dts-v1/;

#include "ipq9574-rdp-common.dtsi"

/ {
	model = "Qualcomm Technologies, Inc. IPQ9574/RDP449";
	compatible = "qcom,ipq9574-rdp449", "qcom,ipq9574";

};
