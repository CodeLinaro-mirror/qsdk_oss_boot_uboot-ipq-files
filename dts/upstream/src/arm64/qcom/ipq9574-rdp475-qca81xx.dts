// SPDX-License-Identifier: GPL-2.0-only
/*
 * Copyright (c) Qualcomm Technologies, Inc. and/or its subsidiaries.
 */

/dts-v1/;

#include "ipq9574-rdp-common.dtsi"

/ {
	model = "Qualcomm Technologies, Inc. IPQ9574/RDP475-QCA81XX";
	compatible = "qcom,ipq9574-rdp475-qca81xx", "qcom,ipq9574";
};
