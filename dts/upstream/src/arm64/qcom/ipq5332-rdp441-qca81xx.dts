// SPDX-License-Identifier: GPL-2.0-only
/*
 * Copyright (c) Qualcomm Technologies, Inc. and/or its subsidiaries.
 */

/dts-v1/;

#include "ipq5332-rdp-common.dtsi"

/ {
	model = "Qualcomm Technologies, Inc. IPQ5333 RDP441-QCA81XX";
	compatible = "qcom,ipq5332-rdp441-qca81xx", "qcom,ipq5332";
};
